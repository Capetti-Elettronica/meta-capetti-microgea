## conf/machine/imx8qxp-icore.conf
```bitbake
#@TYPE: Machine
#@NAME: i.Core MX8X
#@SOC: i.MX8QXP
#@DESCRIPTION: Machine configuration for Engicam imx8qxp-icore SOM
#@MAINTAINER: <support@engicam.com>

require include/imx8qxp-engicam.inc

MACHINEOVERRIDES =. "mx8-icore:"

KERNEL_DEVICETREE_BASENAME = "imx8qxp-icore"

KERNEL_DEVICETREE:append:use-nxp-bsp = " \
	engicam/${KERNEL_DEVICETREE_BASENAME}-starterkit.dtb \
	engicam/${KERNEL_DEVICETREE_BASENAME}-ctouch2.dtb \
"

UBOOT_DTB_NAME = "${KERNEL_DEVICETREE_BASENAME}.dtb"

UBOOT_CONFIG_BASENAME = "imx8qxp_icore"
UBOOT_CONFIG ??= "sd"
UBOOT_CONFIG[sd] = "${UBOOT_CONFIG_BASENAME}_defconfig,sdcard"

IMX_DEFAULT_BSP = "nxp"

ENGICAM_KERNEL_CONFIG_AARCH64 = "imx8_icore_defconfig"

BOARD_TYPE = "icore"
```
